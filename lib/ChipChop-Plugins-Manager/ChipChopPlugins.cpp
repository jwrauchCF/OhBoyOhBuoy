/*
 * This code is auto generated by the ChipChop.io Development Console 
 * You should avoid manually editing this code as it could produce unexpected results
 * If you need to make any changes to the use of ChipChop plugins in your code
 * the safest option is to use the ChipChop Dev Console to re-build this file
 */
#include <Arduino.h>
#include <LittleFS.h>
#include <ChipChopPlugins.h>
ChipChopPluginsManager ChipChopPlugins;

#include <ChipChopEngine.h> 
extern ChipChopEngine ChipChop;

#include <ChipChop_Includes.h> 

void ChipChopPluginsManager::run(){


    emit_event(PLUGINS_RUN,1);

}

ChipChopPluginsManager::ChipChopPluginsManager(){
    
}

void ChipChopPluginsManager::start(){
    Serial.println("ChipChopPluginsManager::start");
    delay(1000);
    pluginsInit init;
    init.start();

    emit_event(PLUGINS_STARTED,1);

}

void ChipChopPluginsManager::initLittleFS(){

    

    #ifdef ESP32
        
        if(!LittleFS.begin(false /* false: Do not format if mount failed */)) {
            Serial.println(F("Failed to mount LittleFS"));
            if(!LittleFS.begin(true /* true: format */)) {
                Serial.println(F("Failed to format LittleFS"));
            } else {
                Serial.println(F("LittleFS formatted successfully"));
                fileSystemOK = 1;
            }
        } else { // Initial mount success
            Serial.println(F("LittleFS started"));
            fileSystemOK = 1;
        }
        
        Serial.println("fileSystemOK: " + String(fileSystemOK));

    
    #elif ESP8266
        
            LittleFSConfig(true);
            if(!LittleFS.begin()) {
                if(!LittleFS.format()){
                    Serial.println(F("Failed to format LittleFS"));
                }else{
                    LittleFS.begin();
                    Serial.println(F("LittleFS formatted successfully"));
                }

            } else { // Initial mount success
                fileSystemOK = 1;
            }
       
    #endif

   
} 
////////////////////////////////////////
///events handling //////
void ChipChopPluginsManager::addListener(byte event,listenerCallbackType cb){
        for(byte i = 0; i < PLUGINS_TOTAL_EVENTS; i++){
            
            if(_listener_events[i].event == event){
                for(byte x = 0; x < PLUGINS_TOTAL_CALLBACKS; x++){
                    
                    if(!_listener_events[i].callbacks[x]){
                        _listener_events[i].callbacks[x] = cb;
                        return;
                    }
                }
            }else if(_listener_events[i].event == 0){
                _listener_events[i].event = event;
                _listener_events[i].callbacks[0] = cb;
                return;
            }
        }

        // Serial.println(F("ChipChop => Plugins: Exceeded number of event callbacks"));
}

void ChipChopPluginsManager::emit_event(byte event, int data){
    for(byte i = 0; i < PLUGINS_TOTAL_EVENTS; i++){
        if(_listener_events[i].event == event){
            for(byte x = 0; x < PLUGINS_TOTAL_CALLBACKS; x++){
                if(_listener_events[i].callbacks[x]){
                    // Serial.print("firing callback: ");
                    // Serial.println(i);
                    _listener_events[i].callbacks[x](data);
                }
            }

            return;
        }
    }
}


//////////